## config/west.yml
```yaml
manifest:
  remotes:
    - name: zmkfirmware
      url-base: https://github.com/zmkfirmware
    - name: gpeye
      url-base: https://github.com/GPeye
    - name: tokyo2006
      url-base: https://github.com/tokyo2006
    - name: englmaxi
      url-base: https://github.com/englmaxi
    - name: dhruvinsh
      url-base: https://github.com/dhruvinsh
    - name: prospector
      url-base: https://github.com/t-ogura
  projects:
    - name: mario-peripheral-animation
      remote: gpeye
      revision: main 
    - name: zmk
      remote: zmkfirmware
      revision: main
      import: app/west.yml
    - name: prospector-zmk-module                 # <--- and these
      remote: tokyo2006                          # <---
      revision: micro_spi2  
    - name: zmk-dongle-display
      remote: englmaxi
      revision: main
    - name: zmk-tri-state
      remote: dhruvinsh
      revision: main
    - name: prospector-zmk-module
      remote: prospector
      revision: v1.1.1
      path: modules/prospector-zmk-module
  self:
    path: config
```
